## Documentation/devicetree/bindings/input/cirrus,cs40l25a.yaml
```yaml
# SPDX-License-Identifier: (GPL-2.0-only OR BSD-2-Clause)
%YAML 1.2
---
$id: http://devicetree.org/schemas/input/cirrus,cs40l25a.yaml#
$schema: http://devicetree.org/meta-schemas/core.yaml#

title: Cirrus Logic CS40L25A boosted haptic driver

maintainers:
  - saiththerobo <the.tom.sharp@gmail.com>

description:
  The CS40L25A is a boosted class-D amplifier with a Halo Core DSP that
  drives a linear resonant actuator, controlled over I2C. It boots from
  ROM into a basic mode; the host loads its RAM firmware and plays
  effects through the firmware's mailbox.

properties:
  compatible:
    const: cirrus,cs40l25a

  reg:
    maxItems: 1

  interrupts:
    maxItems: 1

  reset-gpios:
    maxItems: 1
    description: The chip's RESET line; high takes it out of reset.

required:
  - compatible
  - reg
  - reset-gpios

additionalProperties: false

examples:
  - |
    #include <dt-bindings/gpio/gpio.h>

    i2c {
        #address-cells = <1>;
        #size-cells = <0>;

        haptics@43 {
            compatible = "cirrus,cs40l25a";
            reg = <0x43>;
            reset-gpios = <&gpio 0 GPIO_ACTIVE_HIGH>;
        };
    };
```

## drivers/thermal/samsung/Kconfig
```kconfig
# SPDX-License-Identifier: GPL-2.0-only
config EXYNOS_THERMAL
	tristate "Exynos thermal management unit driver"
	depends on THERMAL_OF
	depends on HAS_IOMEM
	default ARCH_EXYNOS
	help
	  If you say yes here you get support for the TMU (Thermal Management
	  Unit) driver for Samsung Exynos series of SoCs. This driver initialises
	  the TMU, reports temperature and handles cooling action if defined.
	  This driver uses the Exynos core thermal APIs and TMU configuration
	  data from the supported SoCs.

config GS101_ACPM_THERMAL
	tristate "Google gs101 thermal sensors through ACPM"
	depends on THERMAL_OF
	depends on EXYNOS_ACPM_PROTOCOL
	help
	  Thermal zones for the gs101 TMU sensors (CPU clusters, GPU, ISP,
	  TPU), read from the ACPM firmware that owns the TMU.
```
